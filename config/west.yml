## config/west.yml
```yaml
manifest:
  remotes:
    - name: zmkfirmware
      url-base: https://github.com/zmkfirmware
    - name: manna-harbour
      url-base: https://github.com/manna-harbour/miryoku_zmk.git
  projects:
    - name: zmk
      remote: miryoku_zmk
      revision: main
      import: app/west.yml
  self:
    path: config
```
